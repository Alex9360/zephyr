/*
 * SPDX-FileCopyrightText: <text>Copyright (c) 2026 Infineon Technologies AG,
 * or an affiliate of Infineon Technologies AG. All rights reserved.</text>
 * Copyright (c) 2026 Linumiz
 *
 * SPDX-License-Identifier: Apache-2.0
 */

/dts-v1/;
#include <arm/infineon/cat1c/traveo/cyt4bf/cyt4bf_m7.dtsi>
#include "kit_t2g_b_h_lite_cyt4bf8cds_m0p-pinctrl.dtsi"
#include "kit_t2g_b_h_lite_common.dtsi"

/ {
	model = "Infineon Evaluation Lite board for CYT4BF8CDS M7_0";
	compatible = "infineon,kit_t2g_b_h_lite", "infineon,TVIIBH8M";

	chosen {
		zephyr,sram = &sram_m7_0;
		zephyr,flash = &code_flash0;
		zephyr,code-partition = &m7_0_partition;
		zephyr,dtcm = &dtcm;
		zephyr,itcm = &itcm;
		zephyr,console = &uart0;
		zephyr,shell-uart = &uart0;
	};
};

&gpio_prt0 {
	status = "okay";
};

&uart0 {
	status = "okay";
};
