## boards/infineon/cytvii_b_e_1m_100_cpu/Kconfig.cytvii_b_e_1m_100_cpu
```kconfig
# Copyright (c) 2026 Linumiz
# Copyright (c) 2026 Infineon Technologies AG
# SPDX-License-Identifier: Apache-2.0

config BOARD_CYTVII_B_E_1M_100_CPU
	select SOC_CYT2B75CAE
	select SOC_CYT2BX_CORE_M0PLUS if BOARD_CYTVII_B_E_1M_100_CPU_CYT2B75CAE_M0P
	select SOC_CYT2BX_CORE_M4 if BOARD_CYTVII_B_E_1M_100_CPU_CYT2B75CAE_M4
```

## boards/infineon/cytvii_b_e_1m_100_cpu/board.yml
```yaml
# Copyright (c) 2026 Linumiz
# Copyright (c) 2026 Infineon Technologies AG
# SPDX-License-Identifier: Apache-2.0

board:
  name: cytvii_b_e_1m_100_cpu
  full_name: T2G CYTVII-B-E-1M-100-CPU Evaluation Board
  vendor: infineon
  socs:
  - name: cyt2b75cae
```

## boards/infineon/kit_t2g_b_e_lite/Kconfig.kit_t2g_b_e_lite
```kconfig
# Copyright (c) 2026 Linumiz
# Copyright (c) 2026 Infineon Technologies AG
# SPDX-License-Identifier: Apache-2.0

config BOARD_KIT_T2G_B_E_LITE
	select SOC_CYT2BL5CAE
	select SOC_CYT2BX_CORE_M0PLUS if BOARD_KIT_T2G_B_E_LITE_CYT2BL5CAE_M0P
	select SOC_CYT2BX_CORE_M4 if BOARD_KIT_T2G_B_E_LITE_CYT2BL5CAE_M4
```

## boards/infineon/kit_t2g_b_e_lite/board.yml
```yaml
# Copyright (c) 2026 Linumiz
# Copyright (c) 2026 Infineon Technologies AG
# SPDX-License-Identifier: Apache-2.0

board:
  name: kit_t2g_b_e_lite
  full_name: T2G Body Entry Lite Kit
  vendor: infineon
  socs:
  - name: cyt2bl5cae
```

## boards/infineon/kit_t2g_c2d6m_lite/kit_t2g_c2d6m_lite_cyt4dnjbzs_m0p_defconfig
```kconfig
#
# Copyright (c) 2026 Linumiz
# SPDX-License-Identifier: Apache-2.0
#

# General configuration
CONFIG_BUILD_OUTPUT_HEX=y
CONFIG_BUILD_OUTPUT_BIN=y
CONFIG_USE_DT_CODE_PARTITION=y

# Enable M7
CONFIG_INFINEON_CAT1C_START_M7_0=y
CONFIG_INFINEON_CAT1C_START_M7_1=y

CONFIG_GPIO=y

# Enable UART driver
CONFIG_SERIAL=y

# Enable console if required
CONFIG_CONSOLE=y
CONFIG_UART_CONSOLE=y
```

## drivers/audio/Kconfig.tlv320aic26
```kconfig
config AUDIO_CODEC_TLV320AIC26
	bool "TLV320AIC26 Audio Codec"
	default y
	depends on DT_HAS_TI_TLV320AIC26_ENABLED
	depends on SPI
	help
	  Enable the TI TLV320AIC26 low power stereo audio codec driver.
	  Uses SPI for register control and I2S for audio data.

if AUDIO_CODEC_TLV320AIC26

config TLV320AIC26_INIT_PRIORITY
	int "TLV320AIC26 init priority"
	default 70

endif
```

## drivers/i2s/Kconfig.i2s_ifx_cat1
```kconfig
# Copyright (c) 2026 Linumiz
#
# SPDX-License-Identifier: Apache-2.0

config I2S_INFINEON_CAT1
	bool "Infineon CAT1 AUDIOSS I2S driver"
	default y
	depends on DT_HAS_INFINEON_CAT1_I2S_ENABLED
	select  USE_INFINEON_I2S
	select DMA 
	help
	  ISR-driven DMA I2S driver for Infineon TRAVEO T2G AUDIOSS block.
	  Supports I2S and Left-Justified formats, stereo only, 8/16/18/20/24/32-bit.

config I2S_IFX_CAT1_TX_QUEUE_SIZE
	int "TX block queue depth"
	default 4
	depends on I2S_INFINEON_CAT1

config I2S_IFX_CAT1_RX_QUEUE_SIZE
	int "RX block queue depth"
	default 4
	depends on I2S_INFINEON_CAT1
```

## drivers/i2s/Kconfig.shell
```kconfig
# Copyright (c) 2026 Linumiz
# SPDX-License-Identifier: Apache-2.0

config I2S_SHELL
	bool "I2S shell"
	depends on SHELL
	help
	  Enable the 'i2s' shell: stream a generated test tone over any I2S
	  controller ('i2s tone' / 'i2s stop' / 'i2s info'). Transport only;
	  pair it with the 'codec' shell to route the audio through a codec.

if I2S_SHELL

config I2S_SHELL_STACK_SIZE
	int "I2S shell streaming thread stack size"
	default 1536
	help
	  Stack size for the background thread that feeds PCM blocks to I2S.

config I2S_SHELL_THREAD_PRIO
	int "I2S shell streaming thread priority"
	default 5
	help
	  Priority of the I2S feeder thread.

config I2S_SHELL_BLOCK_FRAMES
	int "Frames per I2S TX block"
	default 64
	help
	  Number of stereo frames in each TX block. Keep this small for
	  FIFO-based controllers (which cap a block at FIFO_DEPTH/2 samples);
	  controllers with deep DMA rings can use more.

config I2S_SHELL_BLOCK_COUNT
	int "Number of I2S TX blocks"
	default 16
	help
	  Number of blocks in the TX slab. More blocks means more buffering
	  at the cost of RAM.

endif # I2S_SHELL
```

## dts/bindings/audio/ti,tlv320aic26.yaml
```yaml
description: |
  Texas Instruments TLV320AIC26 Low Power Stereo Audio Codec.
  Control interface: SPI. Audio interface: I2S.

compatible: "ti,tlv320aic26"

include: [spi-device.yaml]

properties:
  mclk-frequency:
    type: int
    required: true
    description: Master clock frequency in Hz applied to the MCLK pin
```

## dts/bindings/interrupt-controller/infineon,cat1-intc-mux.yaml
```yaml
# Copyright (c) 2026 Linumiz
# SPDX-License-Identifier: Apache-2.0

description: |
  Infineon CAT1 CPUSS interrupt multiplexer channel.

  Each instance represents one NvicMux NVIC line (2nd-level aggregator).
  The reg property is the NvicMux line index. The interrupts property
  specifies the L1 NVIC IRQ that this aggregator is connected to.

  Peripherals referencing this node use 2 cells:
    cell 0 (irq)      - system interrupt number (0..CPUSS_SYSTEM_INT_NR-1)
    cell 1 (priority) - NVIC priority for the parent NVIC line

  Example:
    intmux_ch3: interrupt-controller@3 {
        compatible = "infineon,cat1-intc-mux";
        reg = <3>;
        interrupt-controller;
        #interrupt-cells = <2>;
        interrupts = <3 1>;
    };

    scb0: serial@40600000 {
        interrupt-parent = <&intmux_ch3>;
        interrupts = <18 2>;
    };

compatible: "infineon,cat1-intc-mux"

include: [interrupt-controller.yaml, base.yaml]

properties:
  reg:
    required: true

  "#interrupt-cells":
    const: 2

interrupt-cells:
  - irq
  - priority
```

## soc/infineon/cat1a/cyt2bx/Kconfig
```kconfig
# Copyright (c) 2026 Linumiz
# Copyright (c) 2026 Infineon Technologies AG
# SPDX-License-Identifier: Apache-2.0

if SOC_SERIES_CYT2BX

rsource "*/Kconfig"

endif
```

## soc/infineon/cat1a/cyt2bx/m0p/Kconfig
```kconfig
# Copyright (c) 2026 Linumiz
# Copyright (c) 2026 Infineon Technologies AG
# SPDX-License-Identifier: Apache-2.0

if SOC_SERIES_CYT2BX

config SOC_CYT2BX_CORE_M0PLUS
	bool
	select ARM
	select CPU_CORTEX_M0PLUS
	select CPU_CORTEX_M_HAS_SYSTICK
	select CPU_CORTEX_M_HAS_VTOR
	select CPU_HAS_ARM_MPU
	select SOC_PREP_HOOK

config SOC_CYT2BX_START_M4
	bool "Infineon M4 during M0+ startup"
	default n
	help
	  Enable starting M4 core 0 from M0+ core.

endif # SOC_SERIES_CYT2BX
```

## soc/infineon/cat1a/cyt2bx/m4/Kconfig
```kconfig
# Copyright (c) 2026 Linumiz
# Copyright (c) 2026 Infineon Technologies AG
# SPDX-License-Identifier: Apache-2.0

config SOC_CYT2BX_CORE_M4
	bool
	select ARM
	select CPU_CORTEX_M4
	select CPU_CORTEX_M_HAS_SYSTICK
	select CPU_CORTEX_M_HAS_VTOR
	select CPU_HAS_ARM_MPU
	select CPU_HAS_FPU
	select SOC_PREP_HOOK
```

## soc/infineon/cat1c/Kconfig
```kconfig
# Copyright (c) 2024 Cypress Semiconductor Corporation (an Infineon company) or
# an affiliate of Cypress Semiconductor Corporation
# SPDX-License-Identifier: Apache-2.0

if SOC_FAMILY_INFINEON_CAT1C

rsource "*/Kconfig"

config INFINEON_TRAVEO_FAMILY
	bool "Support for Infineon TRAVEO family PDL driver"
	default n
	help
	  Apply to PDL-based drivers for Infineon TRAVEO SoCs.

endif # SOC_FAMILY_INFINEON_CAT1C
```

## soc/infineon/cat1c/cyt4dn/Kconfig
```kconfig
# Copyright (c) 2026 Linumiz
# Copyright (c) 2026 Infineon Technologies AG
# SPDX-License-Identifier: Apache-2.0

if SOC_SERIES_CYT4DN

rsource "*/Kconfig"

if INFINEON_CAT1C_M7

choice INFINEON_CAT1C_M7_CORE
	prompt "TRAVEO T2G Core Selection"
	default INFINEON_CAT1C_M7_0
	help
	  Choose the targeted M7 core
config INFINEON_CAT1C_M7_0
	bool "Infineon CAT1C M7_0"
config INFINEON_CAT1C_M7_1
	bool "Infineon CAT1C M7_1"
endchoice

endif
endif
```

## soc/infineon/cat1c/cyt4dn/Kconfig.soc
```kconfig
# Copyright (c) 2026 Linumiz
# Copyright (c) 2026 Infineon Technologies AG
# SPDX-License-Identifier: Apache-2.0

# SOC series
config SOC_SERIES_CYT4DN
	bool
	select SOC_FAMILY_INFINEON_CAT1C

config SOC_SERIES
	default "cyt4dn" if SOC_SERIES_CYT4DN

config SOC_CYT4DNJBZS
	bool
	select SOC_SERIES_CYT4DN

config SOC_CYT4DNJBZS_M0PLUS
	bool
	select SOC_CYT4DNJBZS

config SOC_CYT4DNJBZS_M7
	bool
	select SOC_CYT4DNJBZS

config SOC
	default "cyt4dnjbzs" if SOC_CYT4DNJBZS
```

## soc/infineon/cat1c/cyt4dn/m7/Kconfig
```kconfig
# Copyright (c) 2026 Linumiz
# Copyright (c) 2026 Infineon Technologies AG
# SPDX-License-Identifier: Apache-2.0

if SOC_SERIES_CYT4DN

config INFINEON_CAT1C_M7
	bool
	default y if SOC_CYT4DNJBZS_M7
	select ARM
	select CPU_CORTEX_M7
	select CPU_CORTEX_M_HAS_SYSTICK
	select CPU_CORTEX_M_HAS_VTOR
	select CPU_HAS_ARM_MPU
	select CPU_HAS_ICACHE
	select CPU_HAS_DCACHE
	select CPU_HAS_FPU
	select SOC_PREP_HOOK
	select SOC_EARLY_INIT_HOOK

endif
```

## soc/infineon/cat1c/cyt4xx/Kconfig.soc
```kconfig
# Copyright (c) 2026 Linumiz
# Copyright (c) 2026 Infineon Technologies AG
# SPDX-License-Identifier: Apache-2.0

# SOC series
config SOC_SERIES_CYT4XX
	bool
	select SOC_FAMILY_INFINEON_CAT1C
	select SOC_FAMILY_INFINEON_TRAVEO

config SOC_SERIES
	default "cyt4xx" if SOC_SERIES_CYT4XX

config SOC_DIE_CYT4DN
	bool

# cyt4dnjbzs
config SOC_CYT4DNJBZS
	bool
	select SOC_SERIES_CYT4XX
	select SOC_DIE_CYT4DN

config SOC
	default "cyt4dnjbzs" if SOC_CYT4DNJBZS
```

## soc/infineon/cat1c/cyt4xx/m0p/Kconfig
```kconfig
# Copyright (c) 2026 Linumiz
# Copyright (c) 2026 Infineon Technologies AG
# SPDX-License-Identifier: Apache-2.0

if SOC_SERIES_CYT4XX

config SOC_CYT4XX_CORE_M0PLUS
	bool
	default y if SOC_CYT4DNJBZS_M0PLUS || SOC_CYT4BFCCHE_M0PLUS
	select ARM
	select CPU_CORTEX_M0PLUS
	select CPU_CORTEX_M_HAS_SYSTICK
	select CPU_HAS_ARM_MPU
	select CPU_CORTEX_M_HAS_VTOR
	select SOC_PREP_HOOK

config SOC_CYT4XX_START_M7_0
	bool "CYT4XX M7 Core 0 during M0+ startup"
	help
	  Enable starting M7 core 0 from M0+ core.

config SOC_CYT4XX_START_M7_1
	bool "CYT4XX M7 Core 1 during M0+ startup"
	help
	  Enable starting M7 core 1 from M0+ core.

endif
```

## soc/infineon/cat1c/cyt4xx/m7/Kconfig
```kconfig
# Copyright (c) 2026 Linumiz
# Copyright (c) 2026 Infineon Technologies AG
# SPDX-License-Identifier: Apache-2.0

if SOC_SERIES_CYT4XX

config SOC_CYT4XX_M7
	bool
	select ARM
	select CPU_CORTEX_M7
	select CPU_CORTEX_M_HAS_SYSTICK
	select CPU_CORTEX_M_HAS_VTOR
	select CPU_HAS_ARM_MPU
	select CPU_HAS_ICACHE
	select CPU_HAS_DCACHE
	select CPU_HAS_FPU
	select SOC_PREP_HOOK
	select SOC_EARLY_INIT_HOOK

config SOC_CYT4XX_CORE_M7_0
	bool
	select SOC_CYT4XX_M7

config SOC_CYT4XX_CORE_M7_1
	bool
	select SOC_CYT4XX_M7

endif
```
