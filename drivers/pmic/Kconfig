## drivers/pmic/Kconfig
```kconfig
menuconfig PMIC
    bool "Power Management IC (PMIC) drivers"
    help
      Enable support for PMIC drivers.

if PMIC

source "drivers/pmic/Kconfig.pmic_mpq7932"

endif # PMIC
```

## drivers/pmic/Kconfig.pmic_mpq7932
```kconfig
config PMIC_MPQ7932
	bool "MPS MPQ7932 driver"
	default y
	depends on I2C
	help
	   Enable the I2C to enable PMIC_MPQ7932 sensor
```

## drivers/regulator/Kconfig.mpq7932
```kconfig
config REGULATOR_MPQ7932
	bool "MPQ7932 sensor"
	depends on I2C && SMBUS
	help
	   I2C should enable to enabling this driver
```

## dts/bindings/i2s/infineon,i2s.yaml
```yaml
# Copyright (c) 2025 Infineon Technologies AG,
# or an affiliate of Infineon Technologies AG.
#
# SPDX-License-Identifier: Apache-2.0

description: Infineon I2S Controller

compatible: "infineon,i2s"

include: [i2s-controller.yaml, pinctrl-device.yaml]

properties:
  reg:
    type: array
    required: true

  system-interrupts:
    type: array
    required: true

  pinctrl-0:
    required: true

  pinctrl-names:
    required: true

  dmas:
    required: true

  dma-names:
    required: true

  ifx,peri-group:
    type: int

  ifx,peri-div:
    type: int
    enum:
      - 0
      - 1
      - 2
      - 3

  ifx,peri-div-inst:
    type: int
```

## dts/bindings/pmic/mps,mpq7932.yaml
```yaml
# SPDX-License-Identifier: Apache-2.0

description: |
  Binding for Monolithic Power Systems MPQ7932 Power Management IC (PMIC)

compatible: "mps,mpq7932"

include: [base.yaml, i2c-device.yaml]

properties:
  reg:
    type: array
    required: true
    description: I2C address of the MPQ7932 device
```

## dts/bindings/regulator/mps,mpq7932.yaml
```yaml
# SPDX-License-Identifier: Apache-2.0

description: |
  Monolithic Power Systems MPQ7932 PMIC with integrated buck regulators.
  Supports 6 buck converters via PMBus over I2C.
  Each buck is represented as a child node with page, voltage, and control.

compatible: "mps,mpq7932"

include:
  - i2c-device.yaml

properties:
  reg:
    type: array
    required: true
    description: I2C address of the MPQ7932 device (usually 0x03 or 0x4B)

  "#address-cells":
    type: int
    const: 1

  "#size-cells":
    type: int
    const: 0

child-binding:
  description: Buck regulator child node
  properties:
    regulator-name:
      type: string
      required: true
      description: |
        Name of the regulator. Used to identify the regulator.

    regulator-page:
      type: int
      required: true
      description: |
        PMBus page number corresponding to the buck regulator.
        0 for BUCK1, 1 for BUCK2, ..., up to 5 for BUCK6.

    regulator-min-microvolt:
      type: int
      required: true
      description: |
        Minimum voltage this regulator can output, in microvolts.

    regulator-max-microvolt:
      type: int
      required: true
      description: |
        Maximum voltage this regulator can output, in microvolts.

    regulator-boot-on:
      type: boolean
      description: |
        If present, the regulator will be enabled at boot.

    regulator-always-on:
      type: boolean
      description: |
        If present, the regulator is always on and cannot be disabled.
```

## mpq7932_project/drivers/mpq7932/Kconfig
```kconfig
config MPQ7932
	bool "MPQ7932 sensor"
	default n
	depends on I2C
	help
	   I2C should enable to enabling this driver
```

## mpq7932_project/dts/bindings/mpq7932_ic/mps,mpq7932.yaml
```yaml
description: Monolithic Power MPQ7932 PMIC

compatible: "mps,mpq7932"

include: [i2c-device.yaml]
child-binding:
  description: Regulator output channel
```
