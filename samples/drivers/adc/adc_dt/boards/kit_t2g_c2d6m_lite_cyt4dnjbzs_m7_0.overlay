#include <zephyr/dt-bindings/adc/adc.h>
/ {
        zephyr,user {
                io-channels = <&adc0 0>;
        };
};

&adc0 {
        #address-cells = <1>;
        #size-cells = <0>;
        channel@0 {
                reg = <0>;
                zephyr,gain = "ADC_GAIN_1";
                zephyr,reference = "ADC_REF_VDD_1";
		zephyr,input-positive = <14>; /* pot */
                zephyr,acquisition-time = <ADC_ACQ_TIME(ADC_ACQ_TIME_MICROSECONDS, 10)>;
                zephyr,resolution = <12>;
        };
};
